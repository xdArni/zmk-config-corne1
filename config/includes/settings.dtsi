// Make sure this file is included before all other files
#include "zmk-helpers/key-labels/42.h"

// Define key groups for 42-key Corne (same as infused-kim repo)
#define KEYS_L LT0 LT1 LT2 LT3 LT4 LM0 LM1 LM2 LM3 LM4 LB0 LB1 LB2 LB3 LB4  // Left hand
#define KEYS_R RT0 RT1 RT2 RT3 RT4 RM0 RM1 RM2 RM3 RM4 RB0 RB1 RB2 RB3 RB4  // Right hand  
#define KEYS_T LH2 LH1 LH0 RH0 RH1 RH2                                         // Thumbs (42-key has 6 thumb keys)
/*
 * Layer Tap Settings
 */
&lt {
    // Increase layer tap time
    tapping-term-ms = <300>;

    // Quickly tap-tap-holding the lt button will repeat the tap behavior
    // For example enter-enter-hold, will output multiple enter while you
    // keep holding the key.
    // But holding enter without double tapping, will activate the layer.
     quick-tap-ms = <200>;

     flavor = "balanced";
};

/*
 * Caps Word Settings
 */
&caps_word {
    // Allow caps word to continue even when minus or underscore
    // are pressed.
    // Also prevent mod presses from cancelling caps word.
    continue-list = <
      UNDERSCORE MINUS
      LCTRL LALT LGUI LSHFT
      RCTRL RALT RGUI RSHFT
      BACKSPACE
    >;
    #ifdef HAS_UROB
        /delete-property/ ignore-modifiers;
    #endif
};

#ifdef HAS_CAPSLOCK
    &caps_word_capslock {
        disable-on-keys = <
            SPACE TAB ENTER ESCAPE
            COMMA DOT SEMI COLON QUESTION EXCLAMATION
            SLASH BACKSLASH SINGLE_QUOTE DOUBLE_QUOTES GRAVE
            LPAR RPAR LBKT RBKT LBRC RBRC LT GT
        >;
    };
#endif

#ifdef HAS_UROB
    &num_word {
        layers = <NUM_WORD>;
        continue-list = <
            BACKSPACE DELETE DOT COMMA
            SLASH ASTERISK PLUS MINUS EQUAL DOLLAR
            RS(SPACE)
        >;
        ignore-modifiers;  // modifiers don't deactivate the layer
    };
#endif
